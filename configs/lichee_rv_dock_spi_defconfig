## configs/lichee_rv_dock_spi_defconfig
```kconfig
CONFIG_RISCV=y
CONFIG_ENV_SIZE=0x10000
CONFIG_DEFAULT_DEVICE_TREE="sun20i-d1-lichee-rv-dock"
CONFIG_SPL_SPI_FLASH_SUPPORT=y
CONFIG_SPL_SPI=y
CONFIG_TARGET_SUN20I_D1=y
CONFIG_ARCH_RV64I=y
CONFIG_RISCV_SMODE=y
# CONFIG_SPL_SMP is not set
CONFIG_SYS_SPL_MALLOC=y
CONFIG_SPL_SPI_LOAD=y
CONFIG_SYS_SPI_U_BOOT_OFFS=0x80000
CONFIG_SPL_OPENSBI_SCRATCH_OPTIONS=0x0
# CONFIG_CMD_SF is not set
CONFIG_ENV_SPI_MAX_HZ=1000000
CONFIG_ENV_SPI_MODE=0x0
CONFIG_SPL_DM_WARN=y
# CONFIG_SYS_I2C_MVTWSI is not set
CONFIG_SF_DEFAULT_MODE=0x3
CONFIG_SF_DEFAULT_SPEED=24000000
CONFIG_SPI_FLASH_SOFT_RESET=y
CONFIG_SPI_FLASH_SOFT_RESET_ON_BOOT=y
CONFIG_SPI_FLASH_BAR=y
CONFIG_SPI_FLASH_GIGADEVICE=y
CONFIG_SPI_FLASH_WINBOND=y
CONFIG_DM_REGULATOR_FIXED=y
CONFIG_SPI=y
# CONFIG_SPL_DM_USB is not set
CONFIG_DM_USB_GADGET=y
CONFIG_USB_MUSB_PIO_ONLY=y
# CONFIG_USB_GADGET is not set
```
